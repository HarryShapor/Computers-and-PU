#include <avr/io.h>	//установка значения в регистр сравнения B
#include <avr/interrupt.h>	//библиотека прерываний
int flag = 0;	//переменная флага для проверки условий
ISR(TIMER1_COMPA_vect)	//прерывание таймера 1 по совпадению с A
{
	PORTD ^= (1 << PORTD0);	//инверсия PORTD0
	if (flag == 0)	//проверка flag на равество 0
	{
		OCR2B = 254;	//установка значения в регистр сравнения B
		flag = 1;	//уставнока переменной flag в 1
	}
	else if (flag == 1)	//проверка flag на равество 1
	{
		OCR2B = 16;	//установка значения в регистр сравнения B
		flag = 2;	//уставнока переменной flag в 2
	}
	else if (flag == 2)	//проверка flag на равество 2
	{
		OCR2B = 24;	//установка значения в регистр сравнения B
		flag = 3;	//уставнока переменной flag в 3
	}
	else if (flag == 3)	//проверка flag на равество 3
	{
		OCR2B = 32;	//установка значения в регистр сравнения B
		flag = 0;	//уставнока переменной flag в 0
	}
}

int main(void)	//главная процедура, точка входа в программу
{
	DDRD = 0xff;	//установка на вывод порта D
	TCCR1A |= (1 << COM1A0) | (1 << COM1A1);
	//инверсный режим вывода OC1A при совпадении
	TCCR1B |= (1 << WGM12) | (1 << CS12) | (0 << CS11) |(1 << CS10);
	//управление режимов работы OC1A и OC1B и установка предделителя 1024
	TIMSK1 |= (1 << OCIE1A);	//разрешение прерывания таймера 1
	OCR1A = 11000;	//установка значения в регистр сравнения A
	TCCR2A |= (1 << COM2A1) | (1 << COM2B1) | (1 << WGM20) | (1 << WGM21);
	//инверсный режим вывода OC2A и OC2B при совпадении и режим ШИМ
	TCCR2B = (1 << WGM22) | (1 << CS22) | (1 << CS21) | (1 << CS20);
	//управление режимов работы OC2A и OC2B и установка предделителя 1024
	OCR2A = 255; //установка значения в регистр сравнения A
	sei();		//глобальные прерывания
    while (1) //бесконечный цикл
    {
    }
}

