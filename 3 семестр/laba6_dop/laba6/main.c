#include <avr/io.h> //библиотеки ввода/вывода
#include <avr/interrupt.h>
char i = 0; //индекс в сообщении
char USB = 0xA0;	//адрес устройства
char x;				//переменная для начала передачи
char y;				//переменная для адреса
char len;			//переменная для длины строки
char Msg[13] = "\nAtmega328P\n";	//сообщение (\n вначале просто по приколу)
char flag = 0x00;					//флаг для условий
ISR (USART0_TX_vect)
{
	if (flag == 0x00 & x == 0x80)	//проверка что начало передачи с 0x80
		flag = 0x01;				//установка следующего флага
	if (flag == 0x01 & UDRE0 != 0 & TXC0 != 0)	//проверка что регистр пустой после начала передачи
	{
		UDR0 = y = 0xA0;						//передача адреса
		flag = 0x02;							//установка следующего флага
	}
	if (flag == 0x02 & y == USB & UDRE0 != 0 &TXC0 != 0)	//проверка что адрес верный
	{
		UDR0 = len = strlen(Msg);							//передача длины сообщения
		flag = 0x03;										//установка следующего флага										
	}
	if (UDRE0 != 0 & TXC0 != 0 & flag == 0x03)				//проверка что флаг 0x03(т е всё до этого было верным)
	{
		if (i <= len)										//проверка на конец строки
			UDR0 = Msg[i++];								//передача символа строки
		else 
		{	
			UDR0 = 0xF0;									//передача конца передачи
		}
	}

}

int main(void)
{

	UBRR0 = 3; //скорость
	UCSR0B |= (1<<TXEN0) | (1 << TXCIE0);	//разрешение отправки данных
	UCSR0C |= (1<<UCSZ01) | (1<<UCSZ00);	//размер пакета 8бит
	sei();	//глобальное разрешение прерываний
	UDR0 = x = 0x80;	//начало передачи
	while (1)	//бесконечный цикл
	{
	}
}
