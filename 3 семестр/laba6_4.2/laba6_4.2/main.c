#include <avr/io.h> //библиотеки ввода/вывода
#include <avr/interrupt.h>	//библиотека обработки прерываний
char x = 0x00;				//инициализация параметра x
char i = 0x00;				//инициализация параметра i
char y;						//инициализация параметра y
char Msg[];					//инициализация массива для сообщения
ISR (USART0_TX_vect)		//обработчик прерывания USART_TX
{
	if (i <= strlen(Msg) & UDRE0 != 0 & TXC0 != 0) //проверка, на то, что не 
	{											   //конец строки и передачи предыдущих данных
		UDR0 = Msg[i++];						   //передача следующего символа из Msg в UDR0
	}
	if (i >= strlen(Msg))						   //проверка на конец строки
	{
		i = 0;									   //проверка на конец строки
		UCSR0B &= 0xBF;							   //запрет передачи данных
	}
}
ISR (USART0_RX_vect)		//обработчик прерывания USART_RX
{
	if (UDR0 != 0x2E)		//проверка, что принят не "."
	{
		if (UDR0 != 0x21)	//проверка, что принят не "!"
			Msg[i++] = UDR0;//запись в Msg принятых данных
	}
	else
	{
		UCSR0B &= 0x6F;		//запрет приёма данных и прерывания USART_RX
		i = 0x00;			//обнуление параметра i
		y = Msg[3];			//перестановка местами c и d
		Msg[3] = Msg[4];	
		Msg[4] = y;			
		y = Msg[1];			//перестановка местами a и b
		Msg[1] = Msg[2];
		Msg[2] = y;			
		UDR0 = Msg[i++];	//передача данных в UDR0
	}

}

int main(void)				//точка входа в программу
{
	UBRR0 = 103;			//скорость 9600бит/c при частоте генератора 16МГц
	UCSR0B |= (1 << TXEN0) | (1 << RXEN0) | (1 << TXCIE0);
	UCSR0C |= (1<<UCSZ01) | (1<<UCSZ00);
	sei();					//глобальное разрешение прерываний
	while (1)				//бесконечный цикл
	{	
		if (UDR0 == 0x21)	//проверка, что принят "!"
		{
			x = UDR0;		//приём данных в переменную x
			UCSR0B |= (1 << RXCIE0);	//разрешение прерывания USART_RX
		}
	}
}