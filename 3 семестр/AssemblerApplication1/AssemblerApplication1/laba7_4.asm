.equ CLK = 16000000					
.equ BAUD = 9600
.equ UBRR0_value = CLK/(BAUD * 16) - 1
.org 0x0000						;адрес вектора reset
	jmp Reset					;переход к метке reset
.org 0x002E						;адрес вектора аналогового компаратора
	jmp acomp					;переход к метке acomp
Reset:							;метка обработчика reset (точка входа)
	ldi r16, High(UBRR0_value)
	sts UBRR0H, r16				;установка частоты приёма/передачи
	ldi r16, Low(UBRR0_value)
	sts UBRR0L, r16				;установка частоты приёма/передачи
	ldi r16, (1 << TXEN0)
	sts UCSR0B, r16				;разрешение передачи
	ldi r16, (1 << UCSZ00) | (1 << UCSZ01)
	sts UCSR0C, r16				;длина слова 8 бит
	ldi r16, 0b01001000			;константа для настройки ACSR
	out ACSR, r16				;Загрузка константы из R16 в ACSR
	ldi r19, Low(NorV << 1)		;метка указывает на слово (16 бит) в памяти
	ldi r20, High(NorV << 1)	;0 - младший байт, 1 - старший
	ldi r21, 0x07				;количество байт в сообщении NorV
	sei							;глобальное разрешение прерываний
main:							;метка основной подпрограммы
	mov zl, r19					;передача в zl младшей части адреса сообщения
	mov zh, r20					;передача в zh старшей части адреса сообщения
	mov r18, r21				;количество байт в сообщении
send:							;метка send
	lpm r16, z+					;чтение символа слова из таблицы (ПЗУ)
	sts UDR0, r16				;отправка символа по uart
	subi r18, 0x01				;вычитание 1 из счетчика букв
repeat:							;метка repeat
	lds r17, UCSR0A				;чтение содержания регистра
	bst r17, 5					;запись 5 бита (udre) регистра (ucsr0a) в бит t регистра sreg 
	BRTC repeat					;если t=0
	cpi r18, 0x00				;r18=0?
	breq main					;если да, то повторяем сообщение
	jmp send					;если нет, то следующий символ
acomp:							;метка прерывания ANALOG COMP 
	in r16, ACSR				;чтение регистра ACSR
	bst r16, 5					;записать 5ый бит регистра R16 в SREG - бит T
	BRTC ledon					;t-clear
	jmp intexit					;переход к выходу из обработчика
ledon:							;метка ledon
	ldi r19, Low(NorV << 1)		;метка указывает на слово (16 бит) в памяти
	ldi r20, High(NorV << 1)	;0 - младший байт, 1 - старший
	ldi r21, 0x07				;количество байт в сообщении NorV
	reti						;возврат из прерывания
intexit:						;метка intexit
	ldi r19, Low(LowV << 1)		;метка указывает на слово (16 бит) в памяти
	ldi r20, High(LowV << 1)	;0 - младший байт, 1 - старший
	ldi r21, 0x0C				;количество байт в сообщении LowV
	reti						;возврат из прерывания
.cseg							;работа с ПЗУ
LowV: .db "Low Voltage", '\n'	;размещение сообщения в памяти ПЗУ
NorV: .db "Normal", '\n'		;размещение сообщения в памяти ПЗУ
