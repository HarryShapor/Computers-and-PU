#include <avr/io.h>				//библиотеки ввода/вывода
#include <avr/interrupt.h>		//библиотека обработки прерываний
char i = 0;						//идекс символа сообщения
char Low[12] = "Low Voltage\n";	//сообщение Low
char Nor[7] = "Normal\n";		//сообщение Nor
char* x;						//указатель на выбранное сообщение
ISR (USART0_TX_vect)			//прерывание USART_TX
{
	if (i <= strlen(x) & UDRE0 != 0 & TXC0 != 0)
	{							//проверка, на то, что не конец строки и передачи предыдущих данных
		UDR0 = x[i++];			//передача следующего символа из x в UDR0
	}
	if (i >= strlen(x))			//проверка на конец строки
	{
		UCSR0B &= 0b10011111;	//запрет передачи данных и прерывания
		i = 0x00;				//установка в 0 параметра i
	}
}
ISR(ANALOG_COMP_vect)			//прерывание ANALOG COMP
{
	if (!(ACSR & 0b00100000))	//проверка бита ACO
	{
		x = Nor;				//передача сообщения Nor
		UDR0 = x[i++];			//передача первого символа сообщения
	}
	else
	{
		x = Low;				//передача сообщения Low
		UDR0 = x[i++];			//передача первого символа сообщения
	}
	
}
int main(void)
{
    UBRR0 = 103;				//скорость 9600бит/c при частоте генератора 16МГц
	UCSR0B |= (1 << TXEN0) | (1 << TXCIE0);	//разрешение отправки данных по UART и прерывания USART0_TX
	UCSR0C |= (1 << UCSZ00) | (1 << UCSZ01);//размер пакета 8бит	
	ACSR = 0b01001000;			//включение ИОН и разрешение прерывания
	sei();						//глобальное разрешение прерываний		
    while (1)					//бесконечный цикл
    {	//разрешение передачи данных и прерывания
		UCSR0B |= (1 << TXEN0) | (1 << TXCIE0);
    }
}

