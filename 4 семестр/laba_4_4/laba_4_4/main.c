#include <avr/io.h>			//библиотека с логическими именами портов 
#include <avr/interrupt.h>	//библиотека прерываний
int counter = 0;			//переменная для посчёта тактов таймера 2
ISR(ADC_vect){				//прерывание преобразования АЦП
	OCR0A = ADCH;			//уставнока значения в регистр стравнения A таймера 0 значения с АЦП
}
ISR(TIMER2_OVF_vect){		//прерывания таймера 2 по переполнению
	TCNT2 = 6;				//установка счётчика таймера 2 
	counter++;				//инкремент значения counter
	if (counter == 250){		//проверка периода времени
		counter = 0;			//обнуление значения переменной counter
		if (UDRE0 != 0){		//проверка на готовность приёма данных
			UDR0 = TCNT1/100;	//вывод значения частоты по UART
			TCNT1 = 0;		//обнуление счётчика таймера 1
}}}
void timer0()	//функция для инициализации таймера 0
{
	TCCR0A |= (0 << COM0A1) | (1 << COM0A0) | (1 << WGM00) | (1 << WGM01);
	//Настройка TC0 в режиме ШИМ на выводе OC0A (не инверсный режим)
	TCCR0B |= (1 << WGM02) | (0 << CS02) | (1 << CS01) | (1 << CS00);	//запуск таймера с частотой Fclk/64	
}
void uartic()			//функция инициализации UART
{
	UBRR0 = 103;		//главная процедура, точка входа в программу
	UCSR0C |= (1 << UCSZ01) | (1 << UCSZ00);	);//размер пакета 8бит
	UCSR0B |= (1 << TXEN0);	//разрешение передачи данных
}
void adc(){				//функция инициализации АЦП
	ADMUX = (0<<REFS1)|(1<<REFS0)|(1<<ADLAR)|(0<<MUX3)|(0<<MUX2)|(0<<MUX1)|(0<<MUX0);
	//вкл. ацп, реж. непрерывн. преобр., разр. прерывания, частота преобр. = FCPU/128
	ADCSRA = (1<<ADEN)|(1<<ADSC)|(1<<ADATE)|(1<<ADIE)|(1<<ADPS2)|(1<<ADPS1)|(1<<ADPS0);
}
void timer1(){			//функция для инициализации таймера 1
	TCCR1B |= (1 << CS02) | (1 << CS01) | (1 << CS00);  //внешний тактовый источник на выводе T1 по спаду	
}
void timer2(){			//функция для инициализации таймера 2
	TCCR2B |= (0 << CS22) | (1 << CS21) | (1 << CS20); //апуск таймера с частотой Fclk/64	
	TIMSK2 = (1 << TOIE2);	//разрешение прерывания таймера 2 по переполнению
}

int main(void)		//главная процедура, точка входа в программу
{
	DDRD = 0b11000000;	//инициализация портов PD7 и PD6 на вывод
	timer0();		//вызов функции инициализации таймера 0
	uartic();		//вызов функции инициализации UART
	adc();			//вызов функции инициализации АЦП
	timer1();		//вызов функции инициализации таймера 1
	timer2();		//вызов функции инициализации таймера 2
	sei();			//разрешение глобальных прерываний
	while (1)		//бесконечный цикл
	{
	}
}

