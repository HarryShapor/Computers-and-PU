#include <avr/io.h>			//библиотека с логическими именами портов ввода/вывода
#include <avr/interrupt.h>	//библиотека работы с прерываниями
char flag_2 = 0x00;			//флаг проверки для прерывания TIMER2 COMPA
char flag_0 = 0x00;			//флаг проверки для прерывания TIMER0 COMPA
ISR (TIMER0_OVF_vect)		//обработчик прерываний по вектору переполнения Timer0
{
	flag_0 += 0x01;			//инкрементирование переменной flag_0
}
ISR (TIMER1_COMPA_vect)		//обработчик прерываний по вектору совпадения Timer1 c A
{
	PORTB ^= 0x20;			//смена состояния L на противоположное
}
ISR (TIMER0_COMPA_vect)		//обработчик прерываний по вектору совпадения Timer0 c A
{	
	if (flag_0 == 0x5C)		//сравнение значения flag_0 с константой 0x5C
	{
		PORTD ^= 0x01;		//смена состояния RX на противоположное
		flag_0 = 0x00;		//обнуление flag_0
	}
}
ISR (TIMER2_OVF_vect)		//обработчик прерываний по вектору переполнения Timer2
{
	flag_2 += 0x01;			//инкрементирование переменной flag_2
}
ISR (TIMER2_COMPA_vect)		//обработчик прерываний по вектору совпадения Timer2 c A
{
	if (flag_2 == 0x25)		//сравнение значения flag_2 с константой 0x25
	{
		PORTD ^= 0x02;		//смена состояния TX на противоположное
		flag_2 = 0x00;		//обнуление flag_2
	}
}
int main(void)				//главная процедура, точка входа в программу
{
	DDRB = 0x20;			//настройка PORTB5 на вывод информации
	DDRD = 0x03;			//настройка PORTD на вывод информации
	TCCR1A = (1 << COM1A0) | (1 << COM1A1);			//Установка вывода OC0A в 1 при совпадении с A
	TCCR1B = (1 << WGM12) | (1 << CS10) | (1 << CS12);	//Режим счета импульсов (OCR1A) (сброс при совпадении), предделитель clk/1024
	TIMSK1 = (1 << OCIE1A);		//разрешение прерывания TIMER1 COMPA
	OCR1AH = 0x7A;			//старшая часть значения A Timer1
	OCR1AL = 0x12;			//младшая часть значения A Timer1
	TCCR0A = (1 << COM0A0) | (1 << COM0A1) | (1 << WGM01);	//Режим СТС, установка вывода OC0A в 1 при совпадении с A
	TCCR0B = (1 << CS00) | (1 << CS02);	//запуск таймера, предделитель clk/1024
	TIMSK0 = (1 << OCIE0A) | (1 << TOIE0);	//разрешение прерывания TIMER0 COMPA и по переполнению счётчика
	OCR0A = 0xFF;			//значение A Timer0
	TCCR2A = (1 << COM2A0) | (1 << COM2A1) | (1 << WGM21);	//Режим СТС, установка вывода OC0A в 1 при совпадении с A
	TCCR2B = (1 << CS20) | (1 << CS21) | (1 << CS22);	//запуск таймера, предделитель clk/1024
	TIMSK2 = (1 << OCIE2A) | (1 << TOIE0); //разрешение прерывания TIMER2 COMPA и по переполнению счётчика
	OCR2A = 0xFF;			//значение A Timer2
	sei();					//глобальное разрешение прерываний
	while (1)				//бесконечный цикл
	{
	}
}

