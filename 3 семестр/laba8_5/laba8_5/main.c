#include <avr/io.h>			//библиотека с логическими именами портов ввода/вывода
#include <avr/interrupt.h>	//библиотека работы с прерываниями
char flag_2 = 0x00;			//флаг проверки для светодиода L
char flag_1 = 0x00;			//флаг проверки для светодиода TX
char flag_0 = 0x00;			//флаг проверки для светодиода RX
ISR (TIMER1_COMPA_vect)		//обработчик прерываний по вектору совпадения Timer1 c A
{
	flag_0 += 0x01;			//инкрементирование переменной flag_0
	flag_1 += 0x01;			//инкрементирование переменной flag_1
	flag_2 += 0x01;			//инкрементирование переменной flag_2
	if (flag_0 == 0x0F)		//сравнение значения flag_0 с константой 0x0F
	{
		PORTD ^= 0x01;		//смена состояния RX на противоположное
		flag_0 = 0x00;		//обнуление flag_0
	}
	if (flag_1 == 0x06)		//сравнение значения flag_1 с константой 0x06
	{
		PORTD ^= 0x02;		//смена состояния TX на противоположное
		flag_1 = 0x00;		//обнуление flag_1
	}
	if (flag_2 == 0x14)		//сравнение значения flag_2 с константой 0x14
		{
			PORTB ^= 0x20;	//смена состояния L на противоположное
			flag_2 = 0x00;	//обнуление flag_2
		}
	
}
int main(void)				//главная процедура, точка входа в программу
{
	DDRB = 0x20;			//настройка PORTB5 на вывод информации
	DDRD = 0x03;			//настройка PORTD на вывод информации
	TCCR1A = (1 << COM1A0) | (1 << COM1A1);		//Установка вывода OC0A в 1 при совпадении с A
	TCCR1B = (1 << WGM12) | (1 << CS12);		//Режим СТС, предделитель clk/256
	TIMSK1 = (1 << OCIE1A);		//разрешение прерывания TIMER1 COMPA
	OCR1AH = 0x18;				//старшая часть значения A Timer1
	OCR1AL = 0x6A;				//младшая часть значения A Timer1
	sei();					//глобальное разрешение прерываний
	while (1)				//бесконечный цикл
	{
	}
}

